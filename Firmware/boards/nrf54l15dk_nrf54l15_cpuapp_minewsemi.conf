## Firmware/boards/nrf54l15dk_nrf54l15_cpuapp_minewsemi.conf
```kconfig
#
# Copyright (c) 2024 Nordic Semiconductor ASA
#
# SPDX-License-Identifier: LicenseRef-Nordic-5-Clause
#

# Disable SPI
CONFIG_SPI_NOR=n

CONFIG_POWEROFF=y

# Enable Watchdog
CONFIG_NCS_SAMPLE_MATTER_WATCHDOG=n

# Enable LTO to decrease the flash usage.
CONFIG_LTO=y
CONFIG_ISR_TABLES_LOCAL_DECLARATION=y
```
